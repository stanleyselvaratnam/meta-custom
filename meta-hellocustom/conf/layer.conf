## meta-hellocustom/conf/layer.conf
```bitbake
LCONF_VERSION = "7"
BBPATH .= ":${LAYERDIR}"
BBFILES += "${LAYERDIR}/recipes-*/*/*.bb"
BBFILE_COLLECTIONS += "hellocustom"
BBFILE_PATTERN_hellocustom = "^${LAYERDIR}/"
BBFILE_PRIORITY_hellocustom = "6"

LAYERSERIES_COMPAT_hellocustom = "scarthgap"
```

## meta-key/conf/layer.conf
```bitbake
LCONF_VERSION = "7"
BBPATH .= ":${LAYERDIR}"
BBFILES += "${LAYERDIR}/recipes-*/*/*.bb"
BBFILE_COLLECTIONS += "key"
BBFILE_PATTERN_hellocustom = "^${LAYERDIR}/"
BBFILE_PRIORITY_hellocustom = "6"

LAYERSERIES_COMPAT_hellocustom = "scarthgap"
```
